## drivers/media/i2c/emb03/Kconfig
```kconfig
config VIDEO_GC2145_EMB03
	tristate "EMB03 GC2145 board-specific offline candidate"
	depends on I2C && OF && GPIOLIB && VIDEO_V4L2 && MEDIA_CONTROLLER
	depends on VIDEO_V4L2_SUBDEV_API
	select V4L2_FWNODE
	help
	  Original EMB03 GPIO sequencing and single-lane 1280x720 UYVY.
	  Requires exclusive CSI selector ownership and disabled OV5640.
	  Uses factory48,emb03-gc2145 (or legacy polyhex,emb03-gc2145), not the generic gc2145 compatible.
	  No clock frequency is inferred. Not enabled by default.
```

## sound/soc/emb03/Kconfig
```kconfig
config SND_SOC_EMB03_ES8316
	tristate "EMB03 factory PCM ES8316 candidate"
	depends on SND_SOC && I2C && OF && GPIOLIB && COMMON_CLK
	depends on !SND_SOC_ES8316
	select REGMAP_I2C
	select SND_SOC_FSL_SAI
	select SND_SOC_IMX_PCM_DMA
```
